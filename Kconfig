## Kconfig
```kconfig
config ZMK_BEHAVIOR_CHORDIS
    bool
    default y
    depends on DT_HAS_ZMK_BEHAVIOR_CHORD_INPUT_ENABLED

config ZMK_BEHAVIOR_CHORDIS_PASSTHROUGH_WORD
    bool
    default y
    depends on DT_HAS_ZMK_BEHAVIOR_CHORD_INPUT_PASSTHROUGH_WORD_ENABLED

config ZMK_CHORDIS_MAX_CHAR_COMBOS
    int "Maximum number of character-character combos"
    default 80
    help
      Maximum number of character-character combo entries
      (e.g. き+や → きゃ for naginata-style yōon input).
      Each entry takes 12 bytes of RAM.
```

## dts/bindings/behaviors/zmk,behavior-cdis-kana.yaml
```yaml
# Copyright (c) 2026 The ZMK Contributors
# SPDX-License-Identifier: MIT

description: NICOLA Kana Output Behavior

compatible: "zmk,behavior-chord-input-kana"

include: one_param.yaml
```

## dts/bindings/behaviors/zmk,behavior-cdis-passthrough-word.yaml
```yaml
# Copyright (c) 2026 The ZMK Contributors
# SPDX-License-Identifier: MIT

description: |
  NICOLA Passthrough Word Behavior.
  Temporarily enables ASCII passthrough on the NICOLA layer.
  On activation, taps the ime-keycode (default: LANG2) to switch the
  IME to alphabet input mode during an active composition.
  While active, NICOLA keys fall through to the base layer.
  Deactivates on any key not in the continuation set (alpha, numeric,
  modifiers, or the configurable continue-list).

compatible: "zmk,behavior-chord-input-passthrough-word"

include: zero_param.yaml

properties:
  ime-keycode:
    type: int
    required: false
    description: |
      ZMK keycode to tap on activation to switch the IME to alphabet
      input mode. Set to 0 to disable. Default: LANG2 (japanese_eisuu).
  ime-restore-keycode:
    type: int
    required: false
    description: |
      ZMK keycode to tap on deactivation to restore the IME to kana
      input mode. Set to 0 to disable. Default: LANG1 (japanese_kana).
  strict-modifiers:
    type: boolean
    description: |
      When explicit modifiers are held, alphabetic and numeric keys bypass
      built-in continuation and are checked against the continue-list instead.
  continue-list:
    type: array
    required: true
    description: |
      Key codes that should not deactivate passthrough-word mode.
      Alpha (A-Z), numeric (0-9), and modifier keys always continue.
      Example: continue-list = <UNDERSCORE BACKSPACE DELETE MINUS>;
```

## dts/bindings/behaviors/zmk,behavior-cdis-passthrough.yaml
```yaml
# Copyright (c) 2026 The ZMK Contributors
# SPDX-License-Identifier: MIT

description: |
  NICOLA Passthrough Behavior.
  Wraps an arbitrary binding and adds modifier-aware passthrough:
  when any modifier is held, returns TRANSPARENT to let the base
  layer handle the key instead.

compatible: "zmk,behavior-chord-input-passthrough"

include: zero_param.yaml

properties:
  bindings:
    type: phandle-array
    required: true
    description: |
      The inner binding to invoke when no modifier is active.
      Example: bindings = <&kp LCTRL>;
```

## dts/bindings/behaviors/zmk,behavior-cdis-thumb.yaml
```yaml
# Copyright (c) 2026 The ZMK Contributors
# SPDX-License-Identifier: MIT

description: NICOLA Thumb Key Behavior

compatible: "zmk,behavior-chord-input-thumb"

include: one_param.yaml

properties:
  side:
    type: string
    required: true
    enum:
      - "left"
      - "right"
      - "shift2"
      - "shift3"
    description: |
      Which shift type this key provides.
      "left"/"right" are the traditional NICOLA thumb shifts (shift 0/1).
      "shift2"/"shift3" are additional shifts for grid-based shift keys.
  bindings:
    type: phandles
    required: true
    description: |
      Behavior to invoke on thumb tap (e.g., <&kp>).
      The param1 binding cell from the keymap provides the parameter.
```

## dts/bindings/behaviors/zmk,behavior-cdis-toggle.yaml
```yaml
# Copyright (c) 2026 The ZMK Contributors
# SPDX-License-Identifier: MIT

description: NICOLA Mode Toggle Behavior (idempotent layer + IME switch)

compatible: "zmk,behavior-chord-input-toggle"

include: one_param.yaml

properties:
  toggle-action:
    type: string
    required: true
    enum:
      - "on"
      - "off"
    description: Whether this toggles NICOLA mode on or off.
  ime-keycode:
    type: int
    required: true
    description: |
      HID keycode to send for IME switching (LANG1 for kana, LANG2 for alphanumeric).
```

## dts/bindings/behaviors/zmk,behavior-cdis.yaml
```yaml
# Copyright (c) 2026 The ZMK Contributors
# SPDX-License-Identifier: MIT

description: NICOLA Character Key Behavior

compatible: "zmk,behavior-chord-input"

include: zero_param.yaml

properties:
  kana:
    type: array
    required: true
    description: |
      Array of kana codes: <unshifted shift0 shift1 [shift2] [shift3]>.
      Minimum 3 elements (NICOLA compat), maximum 5 (with extra shifts).
      Unused trailing shifts default to KANA_NONE.
  hold-behavior:
    type: phandle
    description: |
      Optional behavior to invoke when this key is held past tapping-term-ms
      (e.g. <&kp> for a modifier). Engine integrates hold-tap natively rather
      than wrapping the key in &mt, to allow combo detection.
  hold-param:
    type: int
    description: |
      Parameter passed to hold-behavior (e.g. LSHFT). Required if
      hold-behavior is set.
  tapping-term-ms:
    type: int
    default: 0
    description: |
      Time in ms before a held key resolves to its hold action. Only used
      when hold-behavior is set. The default value 0 is an inherit
      sentinel: the engine substitutes &cdis_config's
      default-tapping-term-ms (built-in fallback 200 ms). Set explicitly
      to override per key.
  quick-tap-ms:
    type: int
    default: 0
    description: |
      Time in ms within which a repeated press forces tap (repeat-typing
      protection). Only used when hold-behavior is set. The default
      value 0 is an inherit sentinel: the engine substitutes
      &cdis_config's default-quick-tap-ms (built-in fallback 0 = feature
      off). To explicitly disable per key while a non-zero global is
      configured, set the per-key value to 1.
  require-prior-idle-ms:
    type: int
    default: 0
    description: |
      Force this key to resolve as tap if any key was released within
      this many milliseconds before its press. Targets rolling typing
      where an HT key gets caught mid-stream and would otherwise promote
      to HOLD on tapping-term. Default 0 is the inherit
      sentinel: the engine substitutes &cdis_config's
      default-require-prior-idle-ms (built-in fallback 0 = feature off).
      To explicitly disable per key while a non-zero global is
      configured, set the per-key value to 1.
  hold-required-key-positions:
    type: array
    required: false
    default: []
    description: |
      Optional list of key positions that may act as hold partners. Stricter
      than ZMK's standard hold-trigger-key-positions: HOLD only activates if
      the FIRST non-self key pressed during the undecided window is one of
      these positions. Any other partner forces tap immediately, even if the
      tapping-term elapses. Holding the key alone (no partner) still resolves
      to HOLD on tapping-term as usual. Empty list (default) disables the
      restriction entirely (any partner permits HOLD). Renamed from
      hold-trigger-key-positions to avoid confusion with ZMK's looser semantics.
```

## dts/bindings/behaviors/zmk,cdis-char-combo.yaml
```yaml
# Copyright (c) 2026 The ZMK Contributors
# SPDX-License-Identifier: MIT

description: |
  NICOLA character-character combo definition.
  When two character keys with the specified kana IDs are pressed
  simultaneously (within the CHAR_WAIT detection window), the result
  kana is output instead. Combos are bidirectional (order does not matter).

  Used for naginata-style yōon input (e.g. き+や → きゃ).

  Example:
    cdis_combo_kya: cdis_combo_kya {
        compatible = "zmk,chord-input-char-combo";
        kana-a = <KANA_KI>;
        kana-b = <KANA_YA>;
        result = <KANA_KYA>;
    };

compatible: "zmk,chord-input-char-combo"

properties:
  kana-a:
    type: int
    required: true
    description: First kana ID of the combo pair
  kana-b:
    type: int
    required: true
    description: Second kana ID of the combo pair
  result:
    type: int
    required: true
    description: Output kana ID when both keys are pressed simultaneously
```

## dts/bindings/behaviors/zmk,cdis-config.yaml
```yaml
# Copyright (c) 2026 The ZMK Contributors
# SPDX-License-Identifier: MIT

description: NICOLA Global Configuration

compatible: "zmk,chord-input-config"

properties:
  timeout-ms:
    type: int
    default: 100
    description: |
      Simultaneous key press detection window in milliseconds.
      NICOLA spec recommends 50-200ms, with 100ms as the typical default.
  sequential-threshold:
    type: int
    default: 2
    description: |
      Coefficient n for sequential typing detection (spec 5.5.2).
      If t1 > t2 * n, the input is judged as sequential (not simultaneous).
  sequential-min-overlap-ms:
    type: int
    default: 20
    description: |
      Minimum overlap time (t2) in ms. If t2 is below this threshold,
      the input is always judged as sequential regardless of t1.
  default-tapping-term-ms:
    type: int
    default: 200
    description: |
      Global default for hold-tap tapping-term-ms. Applied when a
      character behavior has hold-behavior set but leaves tapping-term-ms
      at the inherit sentinel (0). Lets multi-key home-row-mod setups
      tune all keys at once.
  default-quick-tap-ms:
    type: int
    default: 0
    description: |
      Global default for hold-tap quick-tap-ms (repeat-typing protection
      window). Applied when a character behavior has hold-behavior set
      but leaves quick-tap-ms at the inherit sentinel (0). To explicitly
      disable per key while a non-zero global is configured, set the
      per-key value to 1.
  default-require-prior-idle-ms:
    type: int
    default: 0
    description: |
      Global default for hold-tap require-prior-idle-ms. Applied when a
      character behavior has hold-behavior set but leaves
      require-prior-idle-ms at the inherit sentinel (0). The default 0
      keeps the feature opt-in (legacy behavior).
  hold-after-partner-release-ms:
    type: int
    default: 30
    description: |
      Global default for the short grace period after a plain combo
      partner is released, during which an HT-undecided character key may
      still flip to combo by releasing within the window. If no HT
      releases in time, the HT commits to HOLD and the partner is replayed
      via the base layer. This never makes HOLD commit earlier than
      tapping-term-ms. Keep this much smaller than tapping-term-ms; it
      absorbs release-order jitter rather than defining the primary
      hold/tap threshold.
  auto-off-keys:
    type: array
    description: |
      Array of (modifier_mask, encoded_keycode) pairs. When a modifier
      key matching any pair is held and the corresponding character key
      is pressed while NICOLA is active, NICOLA is automatically
      deactivated (flush + layer off + LANG2).
      Example for Emacs C-x, C-s, M-x:
        auto-off-keys = <(MOD_LCTL|MOD_RCTL) X (MOD_LCTL|MOD_RCTL) S (MOD_LALT|MOD_RALT) X>;
  passthrough-behaviors:
    type: phandles
    description: |
      List of behavior devices whose "active" state triggers NICOLA
      passthrough (keys fall through to the base layer instead of
      producing kana). Intended for behaviors like &caps_word or
      &shift_word that apply implicit modifiers which would corrupt
      romaji output.
      The referenced behavior's device data must have `bool active`
      as its first struct field (matching caps_word / shift_word layout).
      Example:
        passthrough-behaviors = <&shift_word>;
        passthrough-behaviors = <&caps_word &shift_word>;
```
